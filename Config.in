## Config.in
```kconfig
source "$BR2_EXTERNAL_SMARC_SAM67_PATH/package/k3conf/Config.in"
source "$BR2_EXTERNAL_SMARC_SAM67_PATH/package/mspm0flash/Config.in"
source "$BR2_EXTERNAL_SMARC_SAM67_PATH/package/ti-img-rogue-driver/Config.in"
source "$BR2_EXTERNAL_SMARC_SAM67_PATH/package/ti-img-rogue-umlibs/Config.in"
source "$BR2_EXTERNAL_SMARC_SAM67_PATH/package/mesa-pvr/Config.in"
```

## configs/kontron_smarc_sam67_ti_linux_kernel_defconfig
```kconfig
BR2_aarch64=y
BR2_TOOLCHAIN_EXTERNAL=y
BR2_TOOLCHAIN_EXTERNAL_BOOTLIN=y
BR2_PACKAGE_OVERRIDE_FILE="$(BR2_EXTERNAL_SMARC_SAM67_PATH)/local.mk"
BR2_ROOTFS_DEVICE_CREATION_DYNAMIC_EUDEV=y
BR2_ROOTFS_OVERLAY="$(BR2_EXTERNAL_SMARC_SAM67_PATH)/board/kontron/smarc-sam67/rootfs_overlay"
BR2_ROOTFS_POST_BUILD_SCRIPT="$(BR2_EXTERNAL_SMARC_SAM67_PATH)/board/kontron/smarc-sam67/post-build.sh"
BR2_ROOTFS_POST_IMAGE_SCRIPT="support/scripts/genimage.sh"
BR2_ROOTFS_POST_IMAGE_SCRIPT_ARGS="-c $(BINARIES_DIR)/genimage.cfg"
BR2_LINUX_KERNEL=y
BR2_LINUX_KERNEL_CUSTOM_GIT=y
BR2_LINUX_KERNEL_CUSTOM_REPO_URL="https://github.com/kontron/ti-linux-kernel.git"
BR2_LINUX_KERNEL_CUSTOM_REPO_VERSION="47998d7b6023eac03ecdd0d414477260b5e55542"
BR2_LINUX_KERNEL_USE_ARCH_DEFAULT_CONFIG=y
BR2_LINUX_KERNEL_DTS_SUPPORT=y
BR2_LINUX_KERNEL_INTREE_DTS_NAME="ti/k3-j722s-evm"
BR2_LINUX_KERNEL_CUSTOM_DTS_DIR="$(BR2_EXTERNAL_SMARC_SAM67_PATH)/board/kontron/smarc-sam67/dts/ti-kernel"
BR2_LINUX_KERNEL_DTB_KEEP_DIRNAME=y
BR2_LINUX_KERNEL_DTB_OVERLAY_SUPPORT=y
BR2_LINUX_KERNEL_NEEDS_HOST_OPENSSL=y
BR2_PACKAGE_BUSYBOX_SHOW_OTHERS=y
BR2_PACKAGE_ALSA_UTILS=y
BR2_PACKAGE_ALSA_UTILS_AMIXER=y
BR2_PACKAGE_ALSA_UTILS_APLAY=y
BR2_PACKAGE_ALSA_UTILS_SPEAKER_TEST=y
BR2_PACKAGE_MPG123=y
BR2_PACKAGE_BONNIE=y
BR2_PACKAGE_COREMARK=y
BR2_PACKAGE_DHRYSTONE=y
BR2_PACKAGE_FIO=y
BR2_PACKAGE_PLY=y
BR2_PACKAGE_STRACE=y
BR2_PACKAGE_STRESS=y
BR2_PACKAGE_STRESS_NG=y
BR2_PACKAGE_JQ=y
BR2_PACKAGE_DOSFSTOOLS=y
BR2_PACKAGE_DOSFSTOOLS_FSCK_FAT=y
BR2_PACKAGE_DOSFSTOOLS_MKFS_FAT=y
BR2_PACKAGE_E2FSPROGS=y
BR2_PACKAGE_E2FSPROGS_RESIZE2FS=y
BR2_PACKAGE_MMC_UTILS=y
BR2_PACKAGE_MTD=y
BR2_PACKAGE_MTD_FLASH_OTP_DUMP=y
BR2_PACKAGE_MTD_FLASH_OTP_INFO=y
BR2_PACKAGE_MTD_FLASH_OTP_LOCK=y
BR2_PACKAGE_MTD_FLASH_OTP_WRITE=y
BR2_PACKAGE_MTD_FLASH_OTP_ERASE=y
# BR2_PACKAGE_MTD_NANDDUMP is not set
# BR2_PACKAGE_MTD_NANDTEST is not set
# BR2_PACKAGE_MTD_NANDWRITE is not set
# BR2_PACKAGE_MTD_UBIATTACH is not set
# BR2_PACKAGE_MTD_UBICRC32 is not set
# BR2_PACKAGE_MTD_UBIDETACH is not set
# BR2_PACKAGE_MTD_UBIFORMAT is not set
# BR2_PACKAGE_MTD_UBIHEALTHD is not set
# BR2_PACKAGE_MTD_UBIMKVOL is not set
# BR2_PACKAGE_MTD_UBINFO is not set
# BR2_PACKAGE_MTD_UBINIZE is not set
# BR2_PACKAGE_MTD_UBIRENAME is not set
# BR2_PACKAGE_MTD_UBIRMVOL is not set
# BR2_PACKAGE_MTD_UBIRSVOL is not set
# BR2_PACKAGE_MTD_UBIUPDATEVOL is not set
# BR2_PACKAGE_MTD_UBIBLOCK is not set
BR2_PACKAGE_MTD_TESTS=y
BR2_PACKAGE_MTD_FLASH_READTEST=y
BR2_PACKAGE_MTD_FLASH_SPEED=y
BR2_PACKAGE_EDID_DECODE=y
BR2_PACKAGE_HWDATA=y
BR2_PACKAGE_INPUT_EVENT_DAEMON=y
BR2_PACKAGE_LM_SENSORS=y
BR2_PACKAGE_LM_SENSORS_FANCONTROL=y
BR2_PACKAGE_LM_SENSORS_PWMCONFIG=y
BR2_PACKAGE_MDIO_TOOLS=y
BR2_PACKAGE_MEMTESTER=y
BR2_PACKAGE_PCIUTILS=y
BR2_PACKAGE_PICOCOM=y
BR2_PACKAGE_READ_EDID=y
BR2_PACKAGE_RNG_TOOLS=y
BR2_PACKAGE_SPI_TOOLS=y
BR2_PACKAGE_UBOOT_TOOLS=y
BR2_PACKAGE_UBOOT_TOOLS_FIT_SUPPORT=y
BR2_PACKAGE_UBOOT_TOOLS_MKIMAGE=y
BR2_PACKAGE_UBOOT_TOOLS_MKENVIMAGE=y
BR2_PACKAGE_UBOOT_TOOLS_DUMPIMAGE=y
BR2_PACKAGE_UHUBCTL=y
BR2_PACKAGE_KMSXX=y
BR2_PACKAGE_KMSXX_INSTALL_TESTS=y
BR2_PACKAGE_LIBGPIOD2=y
BR2_PACKAGE_LIBGPIOD2_TOOLS=y
BR2_PACKAGE_CAN_UTILS=y
BR2_PACKAGE_DROPBEAR=y
BR2_PACKAGE_ETHTOOL=y
BR2_PACKAGE_GESFTPSERVER=y
BR2_PACKAGE_IPERF=y
BR2_PACKAGE_IPERF3=y
BR2_PACKAGE_IPROUTE2=y
BR2_PACKAGE_TCPDUMP=y
BR2_PACKAGE_WGET=y
BR2_PACKAGE_OPTEE_EXAMPLES=y
BR2_PACKAGE_OPTEE_TEST=y
BR2_PACKAGE_EFIBOOTMGR=y
BR2_TARGET_ROOTFS_EXT2=y
BR2_TARGET_ROOTFS_EXT2_4=y
BR2_TARGET_ROOTFS_EXT2_SIZE="190M"
BR2_TARGET_ARM_TRUSTED_FIRMWARE=y
BR2_TARGET_ARM_TRUSTED_FIRMWARE_CUSTOM_VERSION=y
BR2_TARGET_ARM_TRUSTED_FIRMWARE_CUSTOM_VERSION_VALUE="v2.12"
BR2_TARGET_ARM_TRUSTED_FIRMWARE_PLATFORM="k3"
BR2_TARGET_ARM_TRUSTED_FIRMWARE_TARGET_BOARD="lite"
BR2_TARGET_ARM_TRUSTED_FIRMWARE_BL32_OPTEE=y
BR2_TARGET_OPTEE_OS=y
BR2_TARGET_OPTEE_OS_PLATFORM="k3-am62x"
BR2_TARGET_OPTEE_OS_CORE_IMAGES="tee-raw.bin"
BR2_TARGET_TI_K3_R5_LOADER=y
BR2_TARGET_TI_K3_R5_LOADER_CUSTOM_GIT=y
BR2_TARGET_TI_K3_R5_LOADER_CUSTOM_REPO_URL="https://github.com/kontron/u-boot-smarc-sam67.git"
BR2_TARGET_TI_K3_R5_LOADER_CUSTOM_REPO_VERSION="master"
BR2_TARGET_TI_K3_R5_LOADER_BOARD_DEFCONFIG="kontron_sa67_r5"
BR2_TARGET_UBOOT=y
BR2_TARGET_UBOOT_BUILD_SYSTEM_KCONFIG=y
BR2_TARGET_UBOOT_CUSTOM_GIT=y
BR2_TARGET_UBOOT_CUSTOM_REPO_URL="https://github.com/kontron/u-boot-smarc-sam67.git"
BR2_TARGET_UBOOT_CUSTOM_REPO_VERSION="master"
BR2_TARGET_UBOOT_BOARD_DEFCONFIG="kontron_sa67_a53"
BR2_TARGET_UBOOT_NEEDS_DTC=y
BR2_TARGET_UBOOT_NEEDS_OPENSSL=y
BR2_TARGET_UBOOT_NEEDS_ATF_BL31=y
BR2_TARGET_UBOOT_USE_BINMAN=y
# BR2_TARGET_UBOOT_FORMAT_BIN is not set
BR2_TARGET_UBOOT_FORMAT_IMG=y
BR2_TARGET_UBOOT_SPL=y
BR2_TARGET_UBOOT_SPL_NAME="tispl.bin"
BR2_TARGET_UBOOT_CUSTOM_MAKEOPTS="TEE=$(BINARIES_DIR)/tee-raw.bin"
BR2_PACKAGE_HOST_DOSFSTOOLS=y
BR2_PACKAGE_HOST_GENIMAGE=y
BR2_PACKAGE_HOST_MTOOLS=y
BR2_PACKAGE_HOST_UBOOT_TOOLS=y
BR2_PACKAGE_HOST_UBOOT_TOOLS_ENVIMAGE=y
BR2_PACKAGE_HOST_UBOOT_TOOLS_ENVIMAGE_SIZE="0x8000"
BR2_PACKAGE_HOST_UBOOT_TOOLS_ENVIMAGE_REDUNDANT=y
BR2_PACKAGE_K3CONF=y
```

## package/k3conf/Config.in
```kconfig
config BR2_PACKAGE_K3CONF
	bool "k3conf"
	help
	  A Powerful Diagnostic Tool for Texas Instruments K3 based Processors.

	  https://git.ti.com/cgit/k3conf/k3conf/
```

## package/mesa-pvr/Config.in
```kconfig
config BR2_PACKAGE_MESA_PVR
	bool "mesa-pvr"
	select BR2_PACKAGE_EXPAT
	select BR2_PACKAGE_LIBDRM
	select BR2_PACKAGE_WAYLAND_PROTOCOLS if BR2_PACKAGE_WAYLAND
	select BR2_PACKAGE_ZLIB
	select BR2_PACKAGE_HAS_LIBGBM
	select BR2_PACKAGE_HAS_LIBEGL
	select BR2_PACKAGE_HAS_LIBGLES
	help
	  Mesa 3D, an open-source implementation of the OpenGL
	  specification.

	  http://mesa3d.org

config BR2_PACKAGE_PROVIDES_LIBGBM
	default "mesa-pvr"

config BR2_PACKAGE_PROVIDES_LIBEGL
	default "mesa-pvr"

config BR2_PACKAGE_PROVIDES_LIBGLES
        default "mesa-pvr"
```

## package/mspm0flash/Config.in
```kconfig
config BR2_PACKAGE_MSPM0FLASH
	bool "mspm0flash"
	help
	  Flash and verify firmware binary to a TI MSPM0 mirocontroller.
```

## package/ti-img-rogue-driver/Config.in
```kconfig
config BR2_PACKAGE_TI_IMG_ROGUE_DRIVER
        bool "ti-img-rogue-driver"
        depends on BR2_LINUX_KERNEL
	select BR2_LINUX_NEEDS_MODULES # not using kernel-module infra
        help
          Build the pvrsrvkm.ko kernel module.
```

## package/ti-img-rogue-umlibs/Config.in
```kconfig
comment "ti-img-rogue-umlibs needs a glibc toolchain w/ threads"
	depends on BR2_aarch64
	depends on !BR2_TOOLCHAIN_USES_GLIBC || !BR2_TOOLCHAIN_HAS_THREADS

config BR2_PACKAGE_TI_IMG_ROGUE_UMLIBS
        bool "ti-img-rogue-umlibs"
        depends on BR2_TOOLCHAIN_HAS_THREADS # libdrm
	# pre-built binaries
	depends on BR2_TOOLCHAIN_USES_GLIBC
	depends on BR2_aarch64
	select BR2_PACKAGE_WAYLAND
	select BR2_PACKAGE_MESA_PVR
	select BR2_PACKAGE_TI_ROGUE_DRIVER if BR2_LINUX_KERNEL

        help
          Graphics libraries for the TI CPUs with Imagination Rogue GPU.

	  https://git.ti.com/cgit/graphics/ti-img-rogue-umlibs
```
