/dts-v1/;
/plugin/;

#include <dt-bindings/gpio/gpio.h>

&lcd0_backlight {
	/*
	 * The LCD0_BKLT_EN signal is defined by carrier active HIGH, but the
	 * adapter used defines the enable signal as active LOW. So we need to
	 * invert this here for SMARC EVAL carrier 2.1
	 */
	enable-gpios = <&main_gpio0 29 GPIO_ACTIVE_LOW>;
};
